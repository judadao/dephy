## boards/esp32/zephyr/Kconfig
```kconfig
menuconfig DEPHY_ESP32
    bool "Dephy ESP32 support module"
    default y
    help
      Enables the local Dephy ESP32 support module.
```

## zephyr/Kconfig
```kconfig
menuconfig ESP32_ZEPHYER
    bool "ESP32 Zephyr support module"
    default y
    help
      Enables the local ESP32 Zephyr support module.
```
